## drivers/oplus/Kconfig
```kconfig
# SPDX-License-Identifier: GPL-2.0-only
# Copyright (C) 2018-2020 Oplus. All rights reserved.
config OPLUS_SYSTEM_KERNEL
  bool "config oplus system feature "
  default y
  help
	define this config to add oplus sytstem kernel feature

config OPLUS_FEATURE_DUMP_DEVICE_INFO
  bool "config dump device info"
  default n
  help
	define this config to  dump device info.

config OPLUS_FEATURE_OPROJECT
  tristate "config oplus project info for kernel"
  default n
  help
    define this config to define oplus project
source "drivers/oplus/game_opt/Kconfig"
source "drivers/oplus/wakelock_profiler/Kconfig"
source "drivers/oplus/system/dump_device_info/Kconfig"
source "drivers/oplus/system/acm/Kconfig"
source "drivers/oplus/system/project_info/Kconfig"

#ifdef CONFIG_OPLUS_FEATURE_FDLEAK_CHECK
source "drivers/oplus/system/oplus_fdleak/Kconfig"
#endif /*CONFIG_OPLUS_FEATURE_FDLEAK_CHECK*/

#ifdef OPLUS_FEATURE_MDMFEATURE
source "drivers/oplus/system/mdmfeature/Kconfig"
#endif /*OPLUS_FEATURE_MDMFEATURE*/

#ifdef OPLUS_FEATURE_MIDAS
source "drivers/oplus/system/oplus_midas/Kconfig"
#endif

#ifdef OPLUS_FEATURE_POWERINFO_STANDBY
source "drivers/oplus/wakelock_profiler/Kconfig"
#endif /* OPLUS_FEATURE_POWERINFO_STANDBY */

source "drivers/oplus/system/shutdown_detect/Kconfig"
source "drivers/oplus/oplus_performance/tpp/Kconfig"

config OPLUS_ION_BOOSTPOOL
	bool "Support ION Boost pool"
	default n
	help
	  This driver supports ION boost pool.

config OPLUS_FEATURE_CMDLINE
  tristate "Oplus command line"
  default n
  help
        define this config to get command line.

config OPLUS_FEATURE_ANDROIDBOOT
  tristate "Oplus android boot"
  default n
  help
    define this config to get android boot cmdline.

config OPLUS_FEATURE_FTMMODE
  tristate "Oplus ftm mode"
  default n
  help
      define this config to get ftm mode cmdline.

config OPLUS_FEATURE_CHARGERPRESENT
  tristate "Oplus charger present"
  default n
  help
      define this config to get charger present cmdline.

config OPLUS_FEATURE_BUILDVARIANT
  tristate "Oplus buildvariant"
  default n
  help 
      define this config to get buildvariant cmdline.

config OPLUS_FEATURE_SIMCARDNUM
  tristate "Oplus simcardnum"
  default n
  help
      define this config to get simcardnum cmdline.

config OPLUS_FEATURE_CDT
  tristate "Oplus cdt"
  default n
  help
      define this config to get cdt_integrity cmdline.

config OPLUS_FEATURE_SHUTDOWN_SPEED
	tristate "Oplus shutdown speed"
	default n
	help
	  define this config to get shutdown_speed cmdline.

#Add for NandSwap
source "drivers/oplus/oplus_performance/oplus_nandswap/Kconfig"
```

## drivers/soc/oplus/Kconfig
```kconfig
#ifdef OPLUS_FEATURE_THERMAL_HORAE
source "drivers/soc/oplus/thermal/Kconfig"
#endif /* OPLUS_FEATURE_THERMAL_HORAE */

#ifdef OPLUS_FEATURE_SENSOR_SMEM
source "drivers/soc/oplus/sensor/Kconfig"
#endif /* OPLUS_FEATURE_SENSOR_SMEM */
```
